## boards/shields/slotype/Kconfig.defconfig
```kconfig
if SHIELD_SLOTYPE

config ZMK_KEYBOARD_NAME
    default "Slotype"

endif

if SHIELD_SLOTYPE_LEFT

config ZMK_KEYBOARD_NAME
    default "Slotype"

config ZMK_SPLIT_ROLE_CENTRAL
    default y

endif

if SHIELD_SLOTYPE_LEFT || SHIELD_SLOTYPE_RIGHT

config ZMK_SPLIT
    default y

endif
```

## boards/shields/slotype/Kconfig.shield
```kconfig
config SHIELD_SLOTYPE
    def_bool $(shields_list_contains,slotype)

config SHIELD_SLOTYPE_LEFT
    def_bool $(shields_list_contains,slotype_left)

config SHIELD_SLOTYPE_RIGHT
    def_bool $(shields_list_contains,slotype_right)
```
